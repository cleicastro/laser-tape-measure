#include <Wire.h>
#include <ESP8266WiFi.h>
#include <SoftwareSerial.h>
#include <LiquidCrystal_I2C.h>
#include "secrets.h"

#define BAUD_RATE 9600
#define RX D7
#define TX D8
#define SIZE_BYTES 9
#define TOUCH_PIN D0

SoftwareSerial sensorSerial(RX, TX);
LiquidCrystal_I2C lcd(0x27, 16, 2);

// Tabelas de valores CRC
const byte auchCRCHi[] = {
    0x00, 0xC1, 0x81, 0x40, 0x01, 0xC0, 0x80, 0x41, 0x01, 0xC0,
    0x80, 0x41, 0x00, 0xC1, 0x81, 0x40, 0x01, 0xC0, 0x80, 0x41,
    0x00, 0xC1, 0x81, 0x40, 0x00, 0xC1, 0x81, 0x40, 0x01, 0xC0,
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    0x80, 0x41, 0x00, 0xC1, 0x81, 0x40};

const byte auchCRCLo[] = {
    0x00, 0xC0, 0xC1, 0x01, 0xC3, 0x03, 0x02, 0xC2, 0xC6, 0x06,
    0x07, 0xC7, 0x05, 0xC5, 0xC4, 0x04, 0xCC, 0x0C, 0x0D, 0xCD,
    0x0F, 0xCF, 0xCE, 0x0E, 0x0A, 0xCA, 0xCB, 0x0B, 0xC9, 0x09,
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    0x43, 0x83, 0x41, 0x81, 0x80, 0x40};

byte bufferBytes[SIZE_BYTES];
const byte baud_rate[13] = {0x01, 0x10, 0x00, 0x00, 0x00, 0x02, 0x04, 0x00, 0x01, 0xC2, 0x00, 0xF3, 0x0F}; // Controle baud rate
const byte open_laser[11] = {0x01, 0x10, 0x00, 0x03, 0x00, 0x01, 0x02, 0x00, 0x01, 0x67, 0xA3};            // Open Beam
const byte close_laser[11] = {0x01, 0x10, 0x00, 0x03, 0x00, 0x01, 0x02, 0x00, 0x00, 0xA6, 0x63};           // Close Laser
const byte trig_single[8] = {0x01, 0x03, 0x00, 0x0F, 0x00, 0x02, 0xF4, 0x08};                              // Measure once
const byte trig_successive[8] = {0x01, 0x03, 0x00, 0x01, 0x00, 0x02, 0x95, 0xCB};                          // Successive measurment (5Hz)
const byte read_measure_data[8] = {0x01, 0x03, 0x00, 0x0F, 0x00, 0x02, 0xF4, 0x08};                        // Read measuring distance (don't know what to do with this)

int isTouch;
boolean isVisibleLaser = true;

unsigned long lastTimeReadDistance = 0;
unsigned long currentTime = millis();
const long timeout = 10000;
String message = "Aguarde...";

void setup()
{
  lcd.init();
  lcd.backlight();
  lcd.clear();
  lcd.print("Ryatec Sistemas");

  Serial.begin(BAUD_RATE);
  sensorSerial.begin(BAUD_RATE, SWSERIAL_8N1);
  sensorSerial.setTimeout(0.001);

  pinMode(TOUCH_PIN, INPUT);

  if (!sensorSerial)
  {
    Serial.println("Invalid EspSoftwareSerial pin configuration, check config");
    while (1)
    {
      delay(1000);
    }
  }
  if (isVisibleLaser)
  {
    sensorSerial.write(open_laser, sizeof(open_laser));
  }
  // connectWifi();
}

void loop()
{
  currentTime = millis();
  isTouch = digitalRead(TOUCH_PIN);
  lcd.setCursor(0, 1);

  int remainingTime = (int)(timeout - (currentTime - lastTimeReadDistance)) / 1000;
  if (remainingTime == 0 && !isVisibleLaser)
  {
    isVisibleLaser = true;
  }

  if (currentTime - lastTimeReadDistance >= timeout)
  {
    lcd.print("Clique para medir");
    if (isVisibleLaser)
    {
      sensorSerial.write(open_laser, sizeof(open_laser));
      isVisibleLaser = false;
    }
  }
  else
  {
    lcd.print("Aguarde: " + String(remainingTime));
  }

  if (isTouch == HIGH && currentTime - lastTimeReadDistance >= timeout)
  {
    clearSerialBuffer(sensorSerial);
    delay(10);
    sensorSerial.write(trig_single, sizeof(trig_single));
    uint32_t distance = readMeasuringDistance(sensorSerial);

    lcd.clear();
    Serial.print("Distância medida: ");
    if (distance > 1000)
    {
      message = String(distance / 1000.0) + " m";
      lcd.print(message);
      Serial.println(message);
    }
    else
    {
      message = String(distance / 10.0) + " cm";
      lcd.print(message);
      Serial.println(message);
    }

    lastTimeReadDistance = currentTime;
    sensorSerial.write(close_laser, sizeof(close_laser));
    isVisibleLaser = false;
  }
  delay(1000);
}

uint32_t readMeasuringDistance(SoftwareSerial &serial)
{
  uint32_t measuredDistance = 0;

  // Send request to sensor
  serial.write(read_measure_data, sizeof(read_measure_data));
  delay(200); // Wait for the sensor to respond

  // Read response from sensor
  while (serial.available() < 9)
    ;                                // Wait until all bytes are received
  byte slaveAddress = serial.read(); // Read slave address
  byte functionCode = serial.read(); // Read function code
  byte byteCount = serial.read();    // Read byte count
  byte highByte1 = serial.read();    // Read high byte of register 1
  byte lowByte1 = serial.read();     // Read low byte of register 1
  byte highByte2 = serial.read();    // Read high byte of register 2
  byte lowByte2 = serial.read();     // Read low byte of register 2
  byte crcHigh = serial.read();      // Read CRC high byte
  byte crcLow = serial.read();       // Read CRC low byte

  // Verify CRC (not implemented in this example)

  // Combine received bytes into 32-bit value (big-endian)
  measuredDistance |= (uint32_t)highByte1 << 24;
  measuredDistance |= (uint32_t)lowByte1 << 16;
  measuredDistance |= (uint32_t)highByte2 << 8;
  measuredDistance |= (uint32_t)lowByte2;

  return measuredDistance;
}

void clearSerialBuffer(SoftwareSerial &serial)
{
  while (serial.available() > 0)
  {
    serial.read();
  }
}

void connectWifi()
{
  // Connect to Wi-Fi network with SSID and password
  lcd.setCursor(0, 0);
  lcd.print("Connecting to ");
  lcd.setCursor(0, 1);
  lcd.print(ssid);

  WiFi.begin(ssid, password);
  while (WiFi.status() != WL_CONNECTED)
  {
    delay(500);
    Serial.print(".");
  }

  lcd.clear();
  // Print local IP address
  Serial.println("");
  Serial.println("WiFi connected.");
  Serial.println("IP address: ");
  Serial.println(WiFi.localIP());
  lcd.print("Success.");
}
